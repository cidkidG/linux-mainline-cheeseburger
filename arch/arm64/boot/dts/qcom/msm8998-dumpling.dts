// SPDX-License-Identifier: GPL-2.0
/* Copyright (c) 2016, The Linux Foundation. All rights reserve. */

/dts-v1/

#include "msm8998-cheeseburger.dts"

/ {
  model = "OnePlus 5T (dumpling)"
 
  qcom,board-id = <8 0 17801 54>;
 
 };

 &framebuffer0 {
	reg = <0 0x9d400000 0 0x8e6a00>
	height = <2160>;
	}l

  &bootloader_framebuffer_mem {
	reg = <0 0x9d400000 0 0x8e6a00>;
  };
